## arch/x86/configs/xo_1_defconfig
```kconfig
# core
CONFIG_64BIT=n
CONFIG_SMP=n
CONFIG_HZ_100=y
CONFIG_HZ=100
CONFIG_NO_HZ_IDLE=y
CONFIG_NO_HZ=y
CONFIG_HIGH_RES_TIMERS=y
CONFIG_HPET_TIMER=y
CONFIG_HPET_EMULATE_RTC=y
CONFIG_OLPC=y
CONFIG_BATTERY_OLPC=y
CONFIG_HW_RANDOM=y
CONFIG_HW_RANDOM_INTEL=n
CONFIG_HW_RANDOM_AMD=n
CONFIG_PM_RUNTIME=y
CONFIG_PREEMPT=y
CONFIG_MODULES=y
CONFIG_MODULE_UNLOAD=y
CONFIG_PROC_DEVICETREE=y
CONFIG_DEVTMPFS=y
CONFIG_DEVTMPFS_MOUNT=y
CONFIG_BLK_DEV_LOOP=m
CONFIG_BLK_DEV_RAM=y
CONFIG_CGROUPS=y
CONFIG_SCHED_AUTOGROUP=y
CONFIG_BLK_DEV_INITRD=y
CONFIG_EMBEDDED=y
CONFIG_LEGACY_PTYS=n
CONFIG_DEVKMEM=n
CONFIG_PRINTK_TIME=y
CONFIG_SYSVIPC=y
CONFIG_MAGIC_SYSRQ=y
CONFIG_DEBUG_FS=y

# mmc
CONFIG_MMC=y
CONFIG_MMC_BLOCK=y
CONFIG_MMC_SDHCI=y
CONFIG_MMC_UNSAFE_RESUME=y

# framebuffer
CONFIG_FB=y
CONFIG_FRAMEBUFFER_CONSOLE=y
CONFIG_FONTS=y
CONFIG_FONT_SUN12x22=y
CONFIG_LOGO=y
CONFIG_LOGO_LINUX_MONO=n
CONFIG_LOGO_LINUX_VGA16=n
CONFIG_LOGO_LINUX_CLUT224=y

# disable things
CONFIG_BLK_DEV_BSG=n
CONFIG_X86_MCE=n
CONFIG_PCSPKR_PLATFORM=n
CONFIG_VM86=n
CONFIG_SECCOMP=n
CONFIG_MTRR=n
CONFIG_X86_EXTENDED_PLATFORM=n
CONFIG_X86_SMAP=n
CONFIG_ACPI_AC=n
CONFIG_ACPI_BATTERY=n
CONFIG_LCD_CLASS_DEVICE=n

# dcon
CONFIG_STAGING=y # for DCON
CONFIG_BACKLIGHT_LCD_SUPPORT=y # DCON dependency
CONFIG_FB_OLPC_DCON=y

# rtc
CONFIG_RTC_CLASS=y

# input
CONFIG_MOUSE_PS2_SENTELIC=y
CONFIG_MOUSE_PS2_OLPC=y
CONFIG_MOUSE_PS2_LIFEBOOK=n
CONFIG_MOUSE_PS2_TRACKPOINT=n
CONFIG_MOUSE_PS2_LOGIPS2PP=n
CONFIG_MOUSE_PS2_CYPRESS=n
CONFIG_INPUT_TABLET=y
CONFIG_TABLET_USB_WACOM=m  # requested by Uruguay
CONFIG_INPUT_MISC=y
CONFIG_INPUT_UINPUT=m
CONFIG_INPUT_MOUSEDEV=n
CONFIG_INPUT_EVDEV=y

# USB
CONFIG_USB=y
CONFIG_USB_EHCI_HCD=y
CONFIG_SCSI=y
CONFIG_BLK_DEV_SD=y
CONFIG_USB_STORAGE=y
CONFIG_USB_SERIAL=y
CONFIG_USB_SERIAL_FTDI_SIO=m
CONFIG_USB_LEGOTOWER=m
CONFIG_USB_SISUSBVGA=m
CONFIG_USB_SISUSBVGA_CON=y
CONFIG_USB_LD=m
CONFIG_FB_UDL=m
CONFIG_USB_PRINTER=m

# Networking
CONFIG_NET=y
CONFIG_PACKET=y
CONFIG_UNIX=y
CONFIG_INET=y
CONFIG_IP_MULTICAST=y
CONFIG_IPV6=y
CONFIG_WIRELESS_EXT=y
CONFIG_WEXT_CORE=y
CONFIG_RFKILL=y
CONFIG_CFG80211=y
CONFIG_CFG80211_WEXT=y
CONFIG_WLAN=y
CONFIG_NETDEVICES=y
CONFIG_LIBERTAS=y
CONFIG_LIBERTAS_DEBUG=y
CONFIG_MAC80211=m
CONFIG_ATH_CARDS=y
CONFIG_CARL9170=m  # used by Ntugi group (Kenya)
CONFIG_RT2X00=m  # used by Ntugi group (Kenya)
CONFIG_RT2800USB=m
CONFIG_RT2800USB_RT53XX=y

# Bluetooth
CONFIG_BT=m
CONFIG_BT_RFCOMM=m
CONFIG_BT_RFCOMM_TTY=y
CONFIG_BT_BNEP=m
CONFIG_BT_BNEP_MC_FILTER=y
CONFIG_BT_BNEP_PROTO_FILTER=y
CONFIG_BT_HIDP=m
CONFIG_BT_HCIBTUSB=m
CONFIG_BT_HCIBCM203X=m
CONFIG_BT_HCIBFUSB=m
CONFIG_BT_HCIVHCI=m
CONFIG_BT_ATH3K=m

# sound
CONFIG_SOUND=y
CONFIG_SND=y
CONFIG_SND_USB=y
CONFIG_SND_USB_AUDIO=m

# fs
CONFIG_AUTOFS4_FS=y
CONFIG_TMPFS=y
CONFIG_TMPFS_POSIX_ACL=y
CONFIG_TMPFS_XATTR=y
CONFIG_EXT4_FS=y
CONFIG_EXT4_USE_FOR_EXT23=y
CONFIG_EXT4_FS_POSIX_ACL=y
CONFIG_EXT4_FS_SECURITY=y
CONFIG_VFAT_FS=y
CONFIG_FAT_DEFAULT_IOCHARSET="ascii"
CONFIG_NLS_DEFAULT="utf8"
CONFIG_NLS_CODEPAGE_437=y
CONFIG_NLS_ASCII=y
CONFIG_NLS_UTF8=y
CONFIG_SQUASHFS=m
CONFIG_SQUASHFS_ZLIB=y
CONFIG_ISO9660_FS=m
CONFIG_FUSE_FS=m

# serial console
CONFIG_SERIAL_8250=y
CONFIG_SERIAL_8250_CONSOLE=y
CONFIG_SERIAL_CORE_CONSOLE=y

# camera
CONFIG_MEDIA_SUPPORT=y
CONFIG_MEDIA_CAMERA_SUPPORT=y
CONFIG_MEDIA_USB_SUPPORT=y
CONFIG_MEDIA_PCI_SUPPORT=y
CONFIG_MEDIA_SUBDRV_AUTOSELECT=n
CONFIG_DVB_AU8522=n
CONFIG_DVB_AU8522_V4L=n
CONFIG_DVB_TUNER_DIB0070=n
CONFIG_DVB_TUNER_DIB0090=n
CONFIG_USB_VIDEO_CLASS=m
CONFIG_VIDEO_OV7640=y
CONFIG_V4L_PLATFORM_DRIVERS=y

# XO-1
CONFIG_CC_OPTIMIZE_FOR_SIZE=y
CONFIG_M686=y
CONFIG_MGEODE_LX=y
CONFIG_NOHIGHMEM=y
CONFIG_HW_RANDOM_GEODE=y
CONFIG_HW_RANDOM_VIA=n
CONFIG_MMC_SDHCI_PCI=y
CONFIG_RTC_DRV_CMOS=y
CONFIG_LIBERTAS_USB=m
CONFIG_MFD_CORE=y
CONFIG_MFD_CS5535=y
CONFIG_VIDEO_CAFE_CCIC=m
CONFIG_ACPI=n
CONFIG_OLPC_XO1_PM=y
CONFIG_OLPC_XO1_RTC=y
CONFIG_OLPC_XO1_SCI=y
CONFIG_MTD=y
CONFIG_MTD_REDBOOT_PARTS=y
CONFIG_MTD_REDBOOT_DIRECTORY_BLOCK=0
CONFIG_MTD_BLKDEVS=y
CONFIG_MTD_NAND=y
CONFIG_MTD_NAND_CAFE=y
CONFIG_MTD_UBI=y
CONFIG_LIBERTAS_MESH=y
CONFIG_HWMON=n
CONFIG_FB_GEODE=y
CONFIG_FB_GEODE_GX=n
CONFIG_FB_GEODE_LX=y
CONFIG_SND_CS5535AUDIO=y
CONFIG_USB_UHCI_HCD=n
CONFIG_USB_OHCI_HCD=y
CONFIG_XO1_RFKILL=y
CONFIG_JFFS2_FS=y
CONFIG_JFFS2_FS_WBUF_VERIFY=y
CONFIG_JFFS2_SUMMARY=y
CONFIG_JFFS2_FS_XATTR=y
CONFIG_JFFS2_FS_SECURITY=y
CONFIG_JFFS2_FS_POSIX_ACL=n
CONFIG_JFFS2_COMPRESSION_OPTIONS=y
CONFIG_UBIFS_FS=y
CONFIG_CRYPTO_DEV_GEODE=y
CONFIG_GPIO_CS5535=y
CONFIG_X86_MSR=y  # used by xf86-video-geode
CONFIG_SCx200_ACB=y

CONFIG_CMDLINE_BOOL=y
CONFIG_CMDLINE="console=ttyS0,115200 console=tty0 fbcon=font:SUN12x22 no_console_suspend selinux=0"
```
